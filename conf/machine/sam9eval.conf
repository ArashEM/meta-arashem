## conf/machine/sam9eval.conf
```bitbake
#@TYPE: Machine
#@Name: ATMEL AT91SAM9260EK (SAM9EVAL)
#@DESCRIPTION: Machine configuration for Atmel's evaluation board

require conf/machine/include/at91sam9.inc

MACHINE_FEATURES = "apm ext2 ext3 usbgadget screen"

#Device tree
KERNEL_DEVICETREE = "at91sam9260ek.dtb" 

IMAGE_FSTYPES += " ubi tar.gz ext3"
KERNEL_IMAGETYPE = "uImage"

# Set default load address.
KERNEL_EXTRA_ARGS += " LOADADDR=0x22000000"

# NAND
MKUBIFS_ARGS = " -e 129024 -c 2047 -m 2048  -x lzo"
UBINIZE_ARGS = " -m 2048 -p 128KiB -s 512"

UBI_VOLNAME = "rootfs"

UBOOT_MACHINE = "at91sam9260ek_dataflash_cs0_defconfig"
UBOOT_ENTRYPOINT = "0x20008000"
UBOOT_LOADADDRESS = "0x20008000"
```
